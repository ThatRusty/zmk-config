## config/boards/shields/tiny_dactyl/Kconfig.defconfig
```kconfig
if SHIELD_TINY_DACTYL_LEFT

config ZMK_KEYBOARD_NAME
    default "tdactyl-l" 

config ZMK_SPLIT_BLE_ROLE_CENTRAL
    default y

endif

if SHIELD_TINY_DACTYL_RIGHT

config ZMK_KEYBOARD_NAME
    default "tdactyl-r"

endif

if SHIELD_TINY_DACTYL_LEFT || SHIELD_TINY_DACTYL_RIGHT

config ZMK_SPLIT
    default y

endif
```

## config/boards/shields/tiny_dactyl/Kconfig.shield
```kconfig
config SHIELD_TINY_DACTYL_LEFT
    def_bool $(shields_list_contains,tiny_dactyl-left)

config SHIELD_TINY_DACTYL_RIGHT
    def_bool $(shields_list_contains,tiny_dactyl-right)
```
